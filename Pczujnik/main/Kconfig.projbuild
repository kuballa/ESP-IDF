## Pczujnik/main/Kconfig.projbuild
```kconfig
# put here your custom config value
menu "Example Configuration"
config ESP_WIFI_SSID
    string "WiFi SSID"
    default "myssid"
    help
	SSID (network name) for the example to connect to.

config ESP_WIFI_PASSWORD
    string "WiFi Password"
    default "mypassword"
    help
	WiFi password (WPA or WPA2) for the example to use.
	
config I2C_MASTER_SCL
	int "SCL GPIO Num"
	default 17 if IDF_TARGET_ESP32C3
	default 5 if IDF_TARGET_ESP32 || IDF_TARGET_ESP32S2 || IDF_TARGET_ESP32S3
	help
		GPIO number for I2C Master clock line.

config I2C_MASTER_SDA
	int "SDA GPIO Num"
	default 16 if IDF_TARGET_ESP32C3
	default 4 if IDF_TARGET_ESP32 || IDF_TARGET_ESP32S2 || IDF_TARGET_ESP32S3
	help
		GPIO number for I2C Master data line.
endmenu
```

## Pmqtt-client/main/Kconfig.projbuild
```kconfig
# put here your custom config value
menu "Example Configuration"
config ESP_WIFI_SSID
    string "WiFi SSID"
    default "myssid"
    help
	SSID (network name) for the example to connect to.

config ESP_WIFI_PASSWORD
    string "WiFi Password"
    default "mypassword"
    help
	WiFi password (WPA or WPA2) for the example to use.
	
config MQTT_PUB_TEMP_DHT
	int "SCL GPIO Num"
	default 17 if IDF_TARGET_ESP32C3
	default "temperature_MQTT" if IDF_TARGET_ESP32 || IDF_TARGET_ESP32S2 || IDF_TARGET_ESP32S3
	help
		GPIO number for I2C Master clock line.

config MQTT_PUB_HUM_DHT
	int "SDA GPIO Num"
	default 16 if IDF_TARGET_ESP32C3
	default "pressure_MQTT" if IDF_TARGET_ESP32 || IDF_TARGET_ESP32S2 || IDF_TARGET_ESP32S3
	help
		GPIO number for I2C Master data line.
endmenu
```
